## Kconfig
```kconfig
choice PROSPECTOR_STATUS_SCREEN_LAYOUT
    prompt "Status screen layout"
    default PROSPECTOR_STATUS_SCREEN_RING

config PROSPECTOR_STATUS_SCREEN_RING
    bool "Ring layout"
    help
        Concentric battery rings with WANA-inspired palette.
        Supports 1-3 peripherals; ring count/size/color adapt to ZMK_SPLIT_BLE_PERIPHERAL_COUNT.

endchoice

config PROSPECTOR_ROTATE_DISPLAY_180
    bool "Rotate the display 180 degrees"
    default n

choice PROSPECTOR_MODIFIER_OS
    prompt "Modifier chip style"
    default PROSPECTOR_MODIFIER_OS_GENERIC
    help
      Glyphs shown on the RING modifier chips (CTRL/SHFT/ALT/GUI).
      Generic and Windows use letters; Mac uses ⌃ ⇧ ⌥ ⌘ symbols.

config PROSPECTOR_MODIFIER_OS_GENERIC
    bool "Generic (C, S, A, G)"

config PROSPECTOR_MODIFIER_OS_WINDOWS
    bool "Windows (C, S, A, W)"

config PROSPECTOR_MODIFIER_OS_MAC
    bool "Mac (⌃ ⇧ ⌥ ⌘)"

endchoice

config PROSPECTOR_USE_AMBIENT_LIGHT_SENSOR
    bool "Use ambient light sensor for auto brightness"
    default y

config PROSPECTOR_FIXED_BRIGHTNESS
    int "Fixed display brightness"
    default 50
    range 1 100
    depends on !PROSPECTOR_USE_AMBIENT_LIGHT_SENSOR

config PROSPECTOR_DISPLAY_IDLE_TIMEOUT
    int "Seconds of inactivity before turning the display off"
    default 0
    range 0 86400
    help
      Seconds of inactivity before the Prospector display and backlight turn off.
      Set to 0 to disable automatic display off.
      This timeout is independent from ZMK_IDLE_TIMEOUT and only controls the
      Prospector display/backlight.

config PROSPECTOR_DISPLAY_TOUCH_WAKE
    bool "Wake the display from idle-off with touch"
    default y if PROSPECTOR_DISPLAY_IDLE_TIMEOUT > 0
    select INPUT
    select INPUT_CST816S
    select INPUT_CST816S_INTERRUPT
    select INPUT_CST816S_EV_DEVICE
    help
      Wake the Prospector display and backlight from idle-off when the CST816S
      touch controller reports touch input. This is independent from the RING
      layout's long-press theme toggle and gesture navigation options.

config PROSPECTOR_BRIGHTNESS_KEY_CONTROL
    bool "Control display brightness via keycodes"
    default n
    help
      Enable changing the display backlight brightness from keyboard keycodes.
      The configured keycodes must be emitted from the keyboard keymap, for
      example with &kp F23 and &kp F24.

config PROSPECTOR_BRIGHTNESS_UP_KEYCODE
    int "Keycode for increasing display brightness"
    default 115
    depends on PROSPECTOR_BRIGHTNESS_KEY_CONTROL
    help
      HID keycode that increases display brightness. The default is F24.

config PROSPECTOR_BRIGHTNESS_DOWN_KEYCODE
    int "Keycode for decreasing display brightness"
    default 114
    depends on PROSPECTOR_BRIGHTNESS_KEY_CONTROL
    help
      HID keycode that decreases display brightness. The default is F23.

config PROSPECTOR_BRIGHTNESS_STEP
    int "Display brightness adjustment step"
    default 10
    range 1 100
    depends on PROSPECTOR_BRIGHTNESS_KEY_CONTROL || PROSPECTOR_RING_GESTURE_NAV
    help
      Brightness percentage points to adjust per key press or touch tap.

config PROSPECTOR_LAYER_NAME_UPPERCASE
    bool "Display layer names in uppercase"
    default y
    help
      When enabled, layer names will be converted to uppercase for display.

# ── RING layout dark theme toggle ─────────────────────────────────────

config PROSPECTOR_RING_DARK_TOGGLE_KEY
    bool "Toggle RING dark theme via keycode"
    default n
    depends on PROSPECTOR_STATUS_SCREEN_RING
    help
      When enabled, pressing the configured keycode toggles the RING
      layout between light and dark theme at runtime.

config PROSPECTOR_RING_DARK_TOGGLE_KEYCODE
    int "Keycode for toggling RING dark theme"
    default 111
    depends on PROSPECTOR_RING_DARK_TOGGLE_KEY
    help
      HID keycode that toggles between light and dark theme.
      Default is F20 (111). Brightness keys use F23(114) and F24(115).

config PROSPECTOR_RING_DARK_TOGGLE_TOUCH
    bool "Toggle RING dark theme via display long-press"
    default n
    depends on PROSPECTOR_STATUS_SCREEN_RING
    select INPUT
    select INPUT_CST816S
    select INPUT_CST816S_INTERRUPT
    select INPUT_CST816S_EV_DEVICE
    help
      When enabled, long-pressing the display (~0.7 s) toggles the RING
      layout between light and dark theme. Requires CST816S touch controller
      to be present and configured in the devicetree.

config PROSPECTOR_RING_GESTURE_NAV
    bool "Enable RING main-screen touch gestures"
    default n
    depends on PROSPECTOR_STATUS_SCREEN_RING
    select INPUT
    select INPUT_CST816S
    select INPUT_CST816S_INTERRUPT
    select INPUT_CST816S_EV_DEVICE
    help
      When enabled, RING handles touch gestures directly on the main screen:
      tap the left half to decrease brightness, tap the right half to increase
      brightness, and swipe down then right within a short window to enter the
      bootloader without a confirmation page. Requires CST816S touch controller
      to be present and configured in the devicetree.

config PROSPECTOR_RING_LAST_KEY_DISPLAY
    bool "Display last emitted HID key on RING layout"
    default y
    depends on PROSPECTOR_STATUS_SCREEN_RING
    help
      When enabled, the RING layout shows the last emitted HID keycode
      between the STATE chips and KEYS counter. This is intended as a
      lightweight, optional debugging/visual feedback panel.

# ── RING AI Usage screen ──────────────────────────────────────────────

config PROSPECTOR_RING_AI_USAGE
    bool "Enable RING AI Usage screen"
    default n
    depends on PROSPECTOR_STATUS_SCREEN_RING
    help
      When enabled, the RING layout can switch to an AI Usage screen that
      shows Claude Code / Codex 5h and 7d usage as vertical bar graphs.
      The usage data is supplied by a keyboard-side Raw HID handler (e.g.
      CONFIG_RAWHID_APP_AI_USAGE); without it the bars show no data.

config PROSPECTOR_RING_AI_USAGE_TOGGLE_KEY
    bool "Toggle RING AI Usage screen via keycode press"
    default n
    depends on PROSPECTOR_RING_AI_USAGE
    help
      When enabled, pressing the configured keycode toggles between the
      RING main screen and the AI Usage screen.

config PROSPECTOR_RING_AI_USAGE_TOGGLE_KEYCODE
    int "Keycode for toggling the RING AI Usage screen"
    default 112
    depends on PROSPECTOR_RING_AI_USAGE_TOGGLE_KEY
    help
      HID keycode that toggles the AI Usage screen on press.
      Default is F21 (112). Brightness keys use F23(114)/F24(115) and the
      dark-theme key uses F20(111).

config PROSPECTOR_RING_AI_USAGE_TOGGLE_TOUCH
    bool "Toggle RING AI Usage screen via display double-tap"
    default n
    depends on PROSPECTOR_RING_AI_USAGE
    select INPUT
    select INPUT_CST816S
    select INPUT_CST816S_INTERRUPT
    select INPUT_CST816S_EV_DEVICE
    help
      When enabled, double-tapping the display toggles between the RING
      main screen and the AI Usage screen.
      Requires a CST816S touch controller in the devicetree.
```

## boards/shields/prospector_adapter/src/layouts/ring/Kconfig.defconfig
```kconfig
if PROSPECTOR_STATUS_SCREEN_RING

config ZMK_DISPLAY_STATUS_SCREEN_CUSTOM
    select LV_USE_LABEL
    select LV_USE_ARC
    select LV_COLOR_SCREEN_TRANSP
    select LV_FONT_MONTSERRAT_12
    select LV_FONT_MONTSERRAT_14

endif
```
